## boards/shields/faytl/Kconfig.defconfig
```kconfig
if SHIELD_FAYTL_DONGLE

config ZMK_KEYBOARD_NAME
    default "FAYTL"

config ZMK_SPLIT_ROLE_CENTRAL
    default y

config ZMK_SPLIT_BLE_CENTRAL_PERIPHERALS
    default 2

config ZMK_USB
    default y

endif # SHIELD_FAYTL_DONGLE

if SHIELD_FAYTL_LEFT || SHIELD_FAYTL_RIGHT || SHIELD_FAYTL_DONGLE

config ZMK_SPLIT
    default y

config ZMK_BLE
    default y

endif # SHIELD_FAYTL_LEFT || SHIELD_FAYTL_RIGHT || SHIELD_FAYTL_DONGLE
```

## boards/shields/faytl/Kconfig.shield
```kconfig
config SHIELD_FAYTL_LEFT
    def_bool $(shields_list_contains,faytl_left)

config SHIELD_FAYTL_RIGHT
    def_bool $(shields_list_contains,faytl_right)
```

## config/west.yml
```yaml
manifest:
  defaults:
    revision: v0.3
  remotes:
    - name: zmkfirmware
      url-base: https://github.com/zmkfirmware
    # Additional modules containing boards/shields/custom code can be listed here as well
    # See https://docs.zephyrproject.org/3.2.0/develop/west/manifest.html#projects
  projects:
    - name: zmk
      remote: zmkfirmware
      import: app/west.yml
    - name: zmk-faytl-module
      url: https://github.com/FenickFasa/zmk-faytl-module.git
      revision: main
      path: modules/zmk-faytl-module
  self:
    path: config
```
